/dts-v1/;
/plugin/;

/ {
	compatible = "brcm,bcm2835";

	fragment@0 {
		target-path = "/";
		__overlay__ {
			lcd_gpio: lcd-gpio {
				compatible = "se,lcd-gpio";
				status = "okay";
				
				// Maps to BCM pins 4, 17, 22, 23, 24, 25
				en-gpios = <&gpio 4 0>;
				rs-gpios = <&gpio 17 0>;
				d4-gpios = <&gpio 22 0>;
				d5-gpios = <&gpio 23 0>;
				d6-gpios = <&gpio 24 0>;
				d7-gpios = <&gpio 25 0>;
			};
		};
	};
};
