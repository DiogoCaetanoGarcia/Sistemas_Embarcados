## 4_Tópicos_avançados/4.10_Buildroot/hello_buildroot/Config.in
```kconfig
config BR2_PACKAGE_HELLO_BUILDROOT
	bool "hello_buildroot"
	help
	  Hello Buildroot World!

	  Provides the simplest example you
	  can think of for adding a new
	  package in Buildroot.
```

## 5_Tópicos_avançados/5.6_Aplicações/6_Frequencimetro_4/Config.in
```kconfig
config BR2_PACKAGE_FREQUENCIMETRO
	bool "frequencimetro"
	select BR2_PACKAGE_PIGPIO
	select BR2_TARGET_GENERIC_GETTY
	select BR2_PACKAGE_BUSYBOX_SHOW_OTHERS
	help
	  Frequencimetro com display LCD.
```

## Code/26_Buildroot/hello_buildroot/Config.in
```kconfig
config BR2_PACKAGE_HELLO_BUILDROOTs
	bool "hello_buildroot"
	help
	  Hello Buildroot World!

	  Provides the simplest example you
	  can think of for adding a new
	  package in Buildroot.
```

## Code/27_Aplicações/Frequencimetro_3/Config.in
```kconfig
config BR2_PACKAGE_FREQUENCIMETRO
	bool "frequencimetro"
	select BR2_PACKAGE_WIRINGPI
	help
	  Frequencimetro com display LCD.
```
